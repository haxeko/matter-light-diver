## firmware/sdkconfig.defaults
```kconfig
# ---- common defaults (esp-matter light example lineage) ----
CONFIG_IDF_TARGET="esp32c6"

# Partition table
CONFIG_PARTITION_TABLE_CUSTOM=y
CONFIG_PARTITION_TABLE_CUSTOM_FILENAME="partitions.csv"
CONFIG_PARTITION_TABLE_FILENAME="partitions.csv"
CONFIG_PARTITION_TABLE_OFFSET=0x8000
CONFIG_ESPTOOLPY_FLASHSIZE_4MB=y
CONFIG_ESPTOOLPY_FLASHSIZE="4MB"

# Compiler / FreeRTOS
CONFIG_COMPILER_OPTIMIZATION_SIZE=y
CONFIG_FREERTOS_HZ=1000
CONFIG_ESP_MAIN_TASK_STACK_SIZE=7000
CONFIG_ESP_SYSTEM_EVENT_TASK_STACK_SIZE=4096

# NVS / mbedTLS as used by Matter
CONFIG_NVS_ENCRYPTION=n
CONFIG_MBEDTLS_HARDWARE_AES=n
CONFIG_MBEDTLS_HARDWARE_MPI=n
CONFIG_MBEDTLS_HARDWARE_SHA=n
CONFIG_MBEDTLS_ECJPAKE_C=y
CONFIG_MBEDTLS_KEY_EXCHANGE_ECJPAKE=y
CONFIG_MBEDTLS_HKDF_C=y
CONFIG_MBEDTLS_SSL_PROTO_DTLS=y
CONFIG_MBEDTLS_CMAC_C=y

# Matter
CONFIG_ENABLE_CHIPOBLE=y
CONFIG_BT_ENABLED=y
CONFIG_BT_NIMBLE_ENABLED=y
CONFIG_BT_NIMBLE_EXT_ADV=n
CONFIG_USE_MINIMAL_MDNS=y
CONFIG_ENABLE_OTA_REQUESTOR=y
CONFIG_ESP_MATTER_MAX_DYNAMIC_ENDPOINT_COUNT=4
CONFIG_ENABLE_ESP32_FACTORY_DATA_PROVIDER=n
CONFIG_ENABLE_ESP32_DEVICE_INSTANCE_INFO_PROVIDER=n

# Logging
CONFIG_LOG_DEFAULT_LEVEL_INFO=y
CONFIG_CHIP_LOG_DEFAULT_LEVEL_PROGRESS=y
```
